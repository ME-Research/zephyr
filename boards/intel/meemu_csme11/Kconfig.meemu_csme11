## boards/intel/meemu_csme11/Kconfig.meemu_csme11
```kconfig
# Copyright The Zephyr Project Contributors
# SPDX-License-Identifier: Apache-2.0

config BOARD_MEEMU_CSME11
	select SOC_INTEL_CSME11
```

## boards/intel/meemu_csme11/board.yml
```yaml
board:
  name: meemu_csme11
  full_name: CSME 11 in the meemu emulator
  vendor: intel
  socs:
    - name: intel_csme11
```

## drivers/bbram/Kconfig.intel_csme
```kconfig
# Copyright The Zephyr Project Contributors
# SPDX-License-Identifier: Apache-2.0

config BBRAM_INTEL_CSME_PRTC
	bool "Intel CSME PRTC always-on registers"
	default y
	depends on DT_HAS_INTEL_CSME_PRTC_ENABLED
	depends on INTEL_CSME_ATT
	help
	  The always-on registers of the Intel PCH's PRTC agent, reached by
	  the CSME through an ATT sideband window, as battery-backed RAM.
```

## drivers/crypto/Kconfig.intel_csme
```kconfig
# Copyright The Zephyr Project Contributors
# SPDX-License-Identifier: Apache-2.0

config CRYPTO_INTEL_CSME
	bool "Intel CSME crypto engine"
	default y
	depends on DT_HAS_INTEL_CSME_CRYPTO_ENABLED
	help
	  The Intel CSME's crypto engine: its AES-P unit as an AES-ECB cipher
	  with raw keys or keys held in its secure key storage (SKS), and SKS
	  key derivation.
```

## drivers/entropy/Kconfig.intel_csme
```kconfig
# Copyright The Zephyr Project Contributors
# SPDX-License-Identifier: Apache-2.0

config ENTROPY_INTEL_CSME_DRNG
	bool "Intel CSME DRNG driver"
	default y
	depends on DT_HAS_INTEL_CSME_DRNG_ENABLED
	select ENTROPY_HAS_DRIVER
	depends on INTEL_CSME_ATT
	help
	  The PCH's digital random number generator, reached by the Intel CSME
	  through an ATT sideband window. The boot ROM starts it.
```

## drivers/flash/Kconfig.intel_pch_spi
```kconfig
# Copyright The Zephyr Project Contributors
# SPDX-License-Identifier: Apache-2.0

config FLASH_INTEL_PCH_SPI
	bool "Intel PCH SPI flash controller (CSME view)"
	default y
	depends on DT_HAS_INTEL_PCH_SPI_FLASH_ENABLED
	select FLASH_HAS_DRIVER_ENABLED
	select FLASH_HAS_EXPLICIT_ERASE
	select FLASH_HAS_PAGE_LAYOUT
	select FLASH_HAS_EX_OP
	select FLASH_JESD216
	help
	  The Intel PCH's SPI flash controller as the CSME drives it:
	  hardware-sequenced reads, writes and 4 KiB erases, the flash
	  descriptor's regions, and the RPMC a component offers.
```

## drivers/misc/intel_csme_att/Kconfig
```kconfig
# Copyright The Zephyr Project Contributors
# SPDX-License-Identifier: Apache-2.0

config INTEL_CSME_ATT
	bool "Intel CSME ATT sideband windows"
	default y
	depends on DT_HAS_INTEL_CSME_ATT_ENABLED
	help
	  Maps IOSF sideband agents of the PCH into the CSME's address space
	  through the address translation table's sideband windows, on demand.
	  Drivers of sideband agents use it.

config INTEL_CSME_ATT_INIT_PRIORITY
	int "Intel CSME ATT init priority"
	default 10
	depends on INTEL_CSME_ATT
	help
	  Must come before the drivers of sideband agents.
```

## drivers/misc/intel_csme_heci/Kconfig
```kconfig
# Copyright The Zephyr Project Contributors
# SPDX-License-Identifier: Apache-2.0

config INTEL_CSME_HECI
	bool "Intel CSME HECI firmware status (engine side)"
	default y
	depends on DT_HAS_INTEL_CSME_HECI_ENABLED
	help
	  The engine side of the Intel CSME's HECI functions: the firmware
	  status registers the host reads, the engine's CSR and its host
	  memory (UMA) request.

config INTEL_CSME_HECI_INIT_PRIORITY
	int "Intel CSME HECI init priority"
	default 20
	depends on INTEL_CSME_HECI
```

## drivers/misc/intel_csme_pci_function/Kconfig
```kconfig
# Copyright The Zephyr Project Contributors
# SPDX-License-Identifier: Apache-2.0

config INTEL_CSME_PCI_FUNCTION
	bool "Intel CSME PCI functions without a driver (power management)"
	default y
	depends on DT_HAS_INTEL_CSME_PCI_FUNCTION_ENABLED
	depends on PM_DEVICE
	help
	  PCI functions the Intel CSME must quiesce and put in D3 before it
	  resets or powers down, with no other driver: suspending one does it.
```

## drivers/misc/intel_pch_pmc/Kconfig
```kconfig
# Copyright The Zephyr Project Contributors
# SPDX-License-Identifier: Apache-2.0

config INTEL_PCH_PMC
	bool "Intel PCH PMC (CSME view)"
	default y
	depends on DT_HAS_INTEL_PCH_PMC_ENABLED
	help
	  The Intel PCH power management controller as the CSME drives it:
	  power-event status, IPC messages, retention and patch SRAM, and the
	  CSME reset, power-down and platform reset requests.

config INTEL_PCH_PMC_INIT_PRIORITY
	int "Intel PCH PMC init priority"
	default 20
	depends on INTEL_PCH_PMC
```

## drivers/otp/Kconfig.intel_pch
```kconfig
# Copyright The Zephyr Project Contributors
# SPDX-License-Identifier: Apache-2.0

config OTP_INTEL_PCH_FUSE
	bool "Intel PCH fuse controller (CSME view)"
	default y
	depends on DT_HAS_INTEL_PCH_FUSE_ENABLED
	depends on INTEL_CSME_ATT
	help
	  The Intel PCH's fuse controller as the CSME reaches it through ATT
	  sideband windows: the shadow and sensed fuse arrays, margin sensing
	  and shadow writes.
```

## drivers/retained_mem/Kconfig.intel_csme
```kconfig
# Copyright The Zephyr Project Contributors
# SPDX-License-Identifier: Apache-2.0

config RETAINED_MEM_INTEL_CSME_AON
	bool "Intel CSME AON SRAM retained memory driver"
	default y
	depends on DT_HAS_INTEL_CSME_AON_ENABLED
	depends on INTEL_CSME_ATT
	help
	  The always-on SRAM of the Intel PCH's AON agent, reached by the CSME
	  through an ATT sideband window. It keeps its contents across CSME
	  resets and host sleep states.
```

## dts/bindings/crypto/intel,csme-crypto.yaml
```yaml
# Copyright The Zephyr Project Contributors
# SPDX-License-Identifier: Apache-2.0

description: |
  Intel CSME crypto engine: BAR0 of PCI function 0:01.0 in the CSME root
  space (the boot ROM programs it), with AES, AES-P, SHA and secure key
  storage (SKS) units.

compatible: "intel,csme-crypto"

include: base.yaml

properties:
  reg:
    required: true
```

## dts/bindings/debug/intel,npk-sth.yaml
```yaml
# Copyright The Zephyr Project Contributors
# SPDX-License-Identifier: Apache-2.0

description: |
  Intel trace hub (North Peak) software trace channel: one 64-byte STH
  channel (+0x00 Dn, +0x08 DnM, +0x10 DnTS, +0x18 DnMTS, +0x20 USER,
  +0x28 USER_TS, +0x30 FLAG, +0x34 FLAG_TS). A write to Dn emits a data
  packet of the access size. Used as a console: one D8 write per byte, a
  FLAG write at each line end.

compatible: "intel,npk-sth"

include: base.yaml

properties:
  reg:
    required: true
```

## dts/bindings/flash_controller/intel,pch-spi-flash.yaml
```yaml
# Copyright The Zephyr Project Contributors
# SPDX-License-Identifier: Apache-2.0

description: |
  Intel PCH SPI flash controller as the CSME drives it: BAR0 of PCI
  function 0:19.0 in the CSME root space. Offsets are linear flash
  addresses, the flash descriptor at 0; the components and their sizes
  come from the descriptor.

compatible: "intel,pch-spi-flash"

include: base.yaml

properties:
  reg:
    required: true
```

## dts/bindings/memory-controllers/intel,csme-prtc.yaml
```yaml
# Copyright The Zephyr Project Contributors
# SPDX-License-Identifier: Apache-2.0

description: |
  The Intel PCH's PRTC agent (sideband port 0x8e) as the CSME reaches it
  through an ATT window. Its always-on registers are exposed as
  battery-backed RAM: offset 0 is a free-running seconds counter
  (read-only), offset 0x1c bit 0 a busy flag writes wait for, offset 0x38
  firmware flags and offset 0x40 on scratch registers. They survive CSME
  resets and host power states.

compatible: "intel,csme-prtc"

include: intel,csme-sb-device.yaml

properties:
  regs-offset:
    type: int
    required: true
    description: Offset of the always-on registers in the agent's window

  size:
    type: int
    required: true
    description: Size of the always-on register block in bytes
```

## dts/bindings/misc/intel,csme-att.yaml
```yaml
# Copyright The Zephyr Project Contributors
# SPDX-License-Identifier: Apache-2.0

description: |
  Intel CSME 11 address translation table (ATT). Its sideband windows map
  IOSF sideband agents of the PCH into the engine's address space; the
  driver maps them on demand. Sideband agents are child nodes: their reg is
  the engine address range the window maps, their sideband port and flags
  come from intel,csme-sb-device.yaml.

compatible: "intel,csme-att"

include: base.yaml

bus: intel-csme-sb

properties:
  reg:
    required: true

  reg-names:
    required: true
    description: |
      "primary": the primary (MMIO) windows; "sideband": the sideband
      windows, 0x20 bytes each.

  sideband-windows:
    type: int
    required: true
    description: Number of sideband windows
```

## dts/bindings/misc/intel,csme-heci.yaml
```yaml
# Copyright The Zephyr Project Contributors
# SPDX-License-Identifier: Apache-2.0

description: |
  Engine side of an Intel CSME HECI function (fixed BAR on the CSME-private
  bus): the firmware status registers HFSTS1-6 the host reads, the engine's
  control and status register and, on HECI1, the host memory request.

compatible: "intel,csme-heci"

include: base.yaml

properties:
  reg:
    required: true
```

## dts/bindings/misc/intel,csme-pci-function.yaml
```yaml
# Copyright The Zephyr Project Contributors
# SPDX-License-Identifier: Apache-2.0

description: |
  A PCI function of the Intel CSME's root space or private bus with no
  other driver, which must be quiesced (MSI off, DMA stopped, D3) before the
  engine resets or powers down. reg is its configuration space.

compatible: "intel,csme-pci-function"

include: base.yaml

properties:
  reg:
    required: true

  bar:
    type: int
    description: |
      Address to program in BAR0 if the function is a bus master and its
      DMA must be stopped through its registers.

  intel,smbus:
    type: boolean
    description: The function is an SMBus (SMT) controller.
```

## dts/bindings/misc/intel,csme-sb-agent.yaml
```yaml
# Copyright The Zephyr Project Contributors
# SPDX-License-Identifier: Apache-2.0

description: |
  An IOSF sideband agent reached through an Intel CSME ATT sideband window
  that has no driver of its own; software reads and writes it with the ATT
  helpers (intel_csme_att_sb_read32() and friends).

compatible: "intel,csme-sb-agent"

include: intel,csme-sb-device.yaml
```

## dts/bindings/misc/intel,pch-pmc.yaml
```yaml
# Copyright The Zephyr Project Contributors
# SPDX-License-Identifier: Apache-2.0

description: |
  Intel PCH power management controller as the CSME drives it: PCI
  function 0:1a.0 of the CSME root space. "regs" is BAR0 (power-event
  status, the host-boot handshake, IPC messages, reset and power-down
  requests), "sram" BAR1 (firmware patch and CPU descriptor SRAM), "cfg"
  its configuration space (patch interface, version). The driver programs
  the BARs.

compatible: "intel,pch-pmc"

include: base.yaml

properties:
  reg:
    required: true

  reg-names:
    required: true
```

## dts/bindings/otp/intel,pch-fuse.yaml
```yaml
# Copyright The Zephyr Project Contributors
# SPDX-License-Identifier: Apache-2.0

description: |
  Intel PCH fuse controller as the CSME reaches it: the fuse array and the
  controller are two IOSF sideband agents ("intel,csme-sb-agent" nodes
  behind the ATT). The OTP address space is the array: the shadow copy at
  0x000-0x3ff (0x80 bytes per bank), the sensed copy at 0x400-0x7ff.

compatible: "intel,pch-fuse"

properties:
  intel,array:
    type: phandle
    required: true
    description: The sideband agent of the fuse array

  intel,controller:
    type: phandle
    required: true
    description: The sideband agent of the fuse controller
```

## dts/bindings/retained_mem/intel,csme-aon.yaml
```yaml
# Copyright The Zephyr Project Contributors
# SPDX-License-Identifier: Apache-2.0

description: |
  The Intel PCH's AON agent (sideband port 0xb9) as the CSME reaches it
  through an ATT window: agent registers (+0x54 PMCSR, +0x64 bit 2 "CSME
  down" flag) and the always-on SRAM, exposed as retained memory. The SRAM
  keeps its contents across CSME resets and host Sx states and is lost
  with the suspend well.

compatible: "intel,csme-aon"

include: intel,csme-sb-device.yaml

properties:
  sram-offset:
    type: int
    required: true
    description: Offset of the always-on SRAM in the agent's window

  sram-size:
    type: int
    required: true
    description: Size of the always-on SRAM in bytes
```

## dts/bindings/rng/intel,csme-drng.yaml
```yaml
# Copyright The Zephyr Project Contributors
# SPDX-License-Identifier: Apache-2.0

description: |
  Intel PCH digital random number generator as the CSME reaches it: an
  IOSF sideband agent behind an ATT window. The boot ROM starts it.

compatible: "intel,csme-drng"

include: intel,csme-sb-device.yaml
```
